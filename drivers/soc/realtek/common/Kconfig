## drivers/soc/realtek/common/Kconfig
```kconfig
config RTK_SB2_SECURITY_DEBG
	bool "Realtek system bridge security mode debug"
	default n
	select RTK_SMC_CALL
	help
	  Enable helper functions for Realtek system bridge security mode debug. If unsure, say N.

config RTK_RBUS_BARRIER
	bool "Realtek rbus barrier"
	depends on RTK_MEM_REMAP
	default y
	help
	  Enable helper functions for R-bus barrier. If unsure, say N.

config RTK_MEM_REMAP
	bool "Realtek memory remap"
	default y
	help
	  Enable helper functions for static ioremap. If unsure, say N.

config RTK_ACPU_RELOAD
	bool "Realtek dynamic ACPU reload"
	default n
	help
	  Dynamic ACPU stop/start mechanism. If unsure, say N.

config RTK_IPCSHM_RESET
	bool "Dynamic IPC share memory reset"
	depends on RTK_ACPU_RELOAD
	default n
	help
	  Reset IPC_SHM when performing dynamic ACPU stop/start. If unsure, say N.

config RTK_DC_SYS_PC
	bool "Realtek DC-SYS performance counter"
	default n
	help
	  Realtek DC-SYS performance counter drvier, If unsure, say N.

config RTK_DC_SYS_PC_DEBUGFS
	bool "Debugfs of Realtek DC-SYS performance counter"
	depends on RTK_DC_SYS_PC

config RTK_DC_SYS_PC_EDEV
	bool "Devfreq Event Device of Realtek DC-SYS performance counter"
	depends on RTK_DC_SYS_PC

config RTK_DC_SYS_PC_UIODEV
	bool "UIO device of Realtek DC-SYS performance counter"
	depends on RTK_DC_SYS_PC

config RTK_REGMAP_I2C
	bool
	select REGMAP

config RTK_REGMAP_MMIO
	bool
	select REGMAP

config RTK_REGMAP_SECURE_MMIO
	bool
	select RTK_REGMAP_MMIO
	select RTK_SMC_CALL

config RTK_MMIO
	bool
	select REGMAP_MMIO
	select RTK_REGMAP_SECURE_MMIO if ARCH_RTD16xx

config RTK_SMC_CALL
	bool

config RTK_MCP
	bool "Realtek MCP driver"
	default n
	help
	  Realtek MCP driver

config RTK_REGISTER_TRACKER
	bool

config RTK_PM_RUNTIME_DEBUG
	bool
	depends on PM
	default y
	help
	  additional control sysfs for runtime pm

config RTK_DUMMY_DEVICE
	bool "Dummy device"
	default n
	select POWER_CONTROL_PD_DUMMY
	help
	  A dummy device driver. If unsure, say No.

config RTK_VMX_ULTRA
	bool "VMX ultra boot enable"
	default n
	select RTK_VMX_DRM
	help
	  Set VMX ultra boot enable.

config RTK_VMX_DRM
	bool "VMX DRM"
	default n
	help
	  Enable VMX DRM.

config RTK_DEMOD
	bool "Realtek Demod Driver"
	default y
	depends on ARCH_RTD16xx
	help
	  Demod driver

source "drivers/soc/realtek/common/rpc/Kconfig"
source "drivers/soc/realtek/common/pwrctrl/Kconfig"
source "drivers/soc/realtek/common/Kconfig.workaround"
source "drivers/soc/realtek/common/hse/Kconfig"
```

## drivers/soc/realtek/rtd16xx/Kconfig
```kconfig
menu "RTD16xx Device Drivers"

config THOR_PM_WORKARURD
	bool "System restart workarurd"
	depends on RTK_WATCHDOG
	help
	  For SQA test.

source "drivers/soc/realtek/rtd16xx/rtk_ve/Kconfig"

endmenu #RTD16xx Device Drivers
```
